## config/west.yml
```yaml
manifest:
  remotes:
    - name: zmkfirmware
      url-base: https://github.com/zmkfirmware
    - name: eegil
      url-base: https://github.com/eegil
  projects:
    - name: zzzmk
      remote: eegil
      revision: main
      import: app/west.yml
  self:
    path: config
```
